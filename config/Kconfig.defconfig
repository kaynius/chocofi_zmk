## config/Kconfig.defconfig
```kconfig
config ZMK_KEYBOARD_NAME
  default "chocofi ble"
config CONFIG_ZMK_HID_INDICATORS
  default y
```

## config/boards/shields/tbk_corne/Kconfig.defconfig
```kconfig
if SHIELD_TBK_CORNE_LEFT

config ZMK_KEYBOARD_NAME
    default "Tbk-corne"

config ZMK_SPLIT_ROLE_CENTRAL
    default y

endif

if SHIELD_TBK_CORNE_LEFT || SHIELD_TBK_CORNE_RIGHT

config ZMK_SPLIT
    default y

endif
```

## config/boards/shields/tbk_corne/Kconfig.shield
```kconfig
config SHIELD_TBK_CORNE
    bool

config SHIELD_TBK_CORNE_LEFT
    def_bool $(shields_list_contains,tbk_corne_left)
        select SHIELD_TBK_CORNE 

config SHIELD_TBK_CORNE_RIGHT
    def_bool $(shields_list_contains,tbk_corne_right)
        select SHIELD_TBK_CORNE
```
